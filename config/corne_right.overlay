&pro_micro_i2c {
    status = "okay";

    glidepoint: glidepoint@0 {
        compatible = "cirque,pinnacle";
        reg = <0x2a>;
        status = "ok";
        data-ready-gpios = <&pro_micro 1 (GPIO_ACTIVE_HIGH)>;
        sensitivity = "2x";
        invert-y;
    };
};

&glidepoint_split {
    device = <&glidepoint>;
};